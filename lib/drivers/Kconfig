## lib/drivers/mpu6050/Kconfig
```kconfig
config TMI_DRIVER_MPU6050
	bool "Enable MPU6050 IMU"
	default n
	select I2C
	select FPU
	select SENSOR
	help
	  MPU6050 enable

config TMI_DRIVER_MPU6050_INIT_PRIORITY
	int "MPU6050 init priority"
	default 90
	depends on TMI_DRIVER_MPU6050
	help
	  MPU6050 initialization priority.

if TMI_DRIVER_MPU6050

choice TMI_DRIVER_MPU6050_TRIGGER_MODE
	prompt "Trigger mode"
	default TMI_DRIVER_MPU6050_TRIGGER_NONE
	help
	  Specify the type of triggering used by the driver.

config TMI_DRIVER_MPU6050_TRIGGER_NONE
	bool "No trigger"

config TMI_DRIVER_MPU6050_TRIGGER_GLOBAL_THREAD
	bool "Use global thread"
	depends on GPIO
	select TMI_DRIVER_MPU6050_TRIGGER

config TMI_DRIVER_MPU6050_TRIGGER_OWN_THREAD
	bool "Use own thread"
	depends on GPIO
	select TMI_DRIVER_MPU6050_TRIGGER

endchoice

config TMI_DRIVER_MPU6050_TRIGGER
	bool

config TMI_DRIVER_MPU6050_THREAD_PRIORITY
	int "Thread priority"
	depends on TMI_DRIVER_MPU6050_TRIGGER_OWN_THREAD
	default 10
	help
	  Priority of thread used by the driver to handle interrupts.

config TMI_DRIVER_MPU6050_THREAD_STACK_SIZE
	int "Thread stack size"
	depends on TMI_DRIVER_MPU6050_TRIGGER_OWN_THREAD
	default 1024
	help
	  Stack size of thread used by the driver to handle interrupts.

endif # TMI_DRIVER_MPU6050
```

## lib/drivers/tcs3400/Kconfig
```kconfig
config TMI_DRIVER_TCS3400
	bool "Enable tcs3400 pressure sense"
	default n
	select I2C
	select FPU
	select SENSOR
	help
		Enables the xgzp6897d pressure sense I2C, FPU and PRESSURE_API

config TMI_DRIVER_TCS3400_INIT_PRIORITY
	int "TCS3400	init priority"
	default 90
	depends on TMI_DRIVER_TCS3400
	help
		TCS3400 initialization priority.

if TMI_DRIVER_TCS3400

choice TMI_DRIVER_TCS3400_TRIGGER_MODE
	prompt "Trigger mode"
	default TMI_DRIVER_TCS3400_TRIGGER_NONE
	help
	  Specify the type of triggering used by the driver.

config TMI_DRIVER_TCS3400_TRIGGER_NONE
	bool "No trigger"

config TMI_DRIVER_TCS3400_TRIGGER_GLOBAL_THREAD
	bool "Use global thread"
	depends on GPIO
	select TMI_DRIVER_TCS3400_TRIGGER

config TMI_DRIVER_TCS3400_TRIGGER_OWN_THREAD
	bool "Use own thread"
	depends on GPIO
	select TMI_DRIVER_TCS3400_TRIGGER

endchoice

config TMI_DRIVER_TCS3400_TRIGGER
	bool

config TMI_DRIVER_TCS3400_THREAD_PRIORITY
	int "Thread priority"
	depends on TMI_DRIVER_TCS3400_TRIGGER_OWN_THREAD
	default 10
	help
	  Priority of thread used by the driver to handle interrupts.

config TMI_DRIVER_TCS3400_THREAD_STACK_SIZE
	int "Thread stack size"
	depends on TMI_DRIVER_TCS3400_TRIGGER_OWN_THREAD
	default 1024
	help
	  Stack size of thread used by the driver to handle interrupts.

endif # TMI_DRIVER_TCS3400
```

## lib/drivers/xgzp6897d/Kconfig
```kconfig
config TMI_DRIVER_XGZP6897D
	bool "Enable XGZP6897D Pressure Sensor"
	default y
	depends on DT_HAS_TMI_XGZP6897D_ENABLED
	select I2C
	select SENSOR
	select FPU if CPU_HAS_FPU
	help
		Enables XGZP6897D pressure sensor driver

config TMI_DRIVER_XGZP6897D_INIT_PRIORITY
	int "XGZP6897D	init priority"
	default 90
	depends on TMI_DRIVER_XGZP6897D
	help
		XGZP6897D initialization priority.
```

## lib/dts/bindings/tmi,mpu6050.yaml
```yaml
# Copyright (c) 2019 Nordic Semiconductor ASA
# SPDX-License-Identifier: Apache-2.0

description: MPU-6000 motion tracking device

# MPU-6000 is SPI or I2C.  MPU-6050 is I2C-only.  Driver does not
# support SPI so stick with I2C variant.
compatible: "tmi,mpu6050"

include: [i2c-device.yaml]

properties:

  int-gpios:
    type: phandle-array
    description: |
      Interrupt pin driven by the MPU6050's INT output, used for triggers
      such as data-ready. The INT signal default configuration is
      active-high, push-pull. The property value should ensure the flags
      properly describe the signal presented to the driver.

  accel-fs-mg:
    type: int
    default: 2000
    description: |
      Accelerometer full-scale range in milli-Gs.
      An X value represents a range of +/- X g.
      The power-on reset state of the sensor matches the default value of 2000.
    enum:
      - 2000
      - 4000
      - 8000
      - 16000

  gyro-fs-dps:
    type: int
    default: 250
    description: |
      Gyroscope full-scale range.
      An X value represents a range of +/- X deg/s.
      The power-on reset state of the sensor matches the default value of 250.
    enum:
      - 250
      - 500
      - 1000
      - 2000
```

## lib/dts/bindings/tmi,tcs3400.yaml
```yaml
# Copyright (c) 2019 Nordic Semiconductor ASA
# SPDX-License-Identifier: Apache-2.0

description: TCS3400 color sensing device

compatible: "tmi,tcs3400"

include: [ i2c-device.yaml ]

properties:

  int-gpios:
    type: phandle-array
    description: |
      Interrupt pin driven by the MPU6050's INT output, used for triggers
      such as data-ready. The INT signal default configuration is
      active-high, push-pull. The property value should ensure the flags
      properly describe the signal presented to the driver.
```
