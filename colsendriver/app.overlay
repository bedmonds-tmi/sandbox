/ {
    my_gpios {
        compatible = "gpio-leds";

        my_output: my_output {
            gpios = <&gpio0 14 GPIO_ACTIVE_HIGH>;
            label = "My output GPIO";
        };
    };

    aliases {
        led_en = &my_output;
    };
};