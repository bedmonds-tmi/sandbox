## I2CDriverpractice/build/Kconfig/boards/Kconfig.nrf52840dk
```kconfig
# Load board Kconfig descriptions.
osource "C:/Users/fayez.saad/Developer/projects/test/deps/zephyr/boards/nordic/nrf52840dk/Kconfig.nrf52840dk"
```

## TCS3400sendriver/build/Kconfig/Kconfig.sysbuild.modules
```kconfig
config ZEPHYR_CMSIS_6_MODULE
   bool
   default y
config ZEPHYR_HAL_NORDIC_MODULE
   bool
   default y
```

## TCS3400sendriver/build/Kconfig/arch/Kconfig
```kconfig
# Load Zephyr Arch Kconfig descriptions.
osource "C:/Users/derrell.nofiel/dev/projects/test/deps/zephyr/arch/rx/Kconfig"
osource "C:/Users/derrell.nofiel/dev/projects/test/deps/zephyr/arch/x86/Kconfig"
osource "C:/Users/derrell.nofiel/dev/projects/test/deps/zephyr/arch/xtensa/Kconfig"
osource "C:/Users/derrell.nofiel/dev/projects/test/deps/zephyr/arch/sparc/Kconfig"
osource "C:/Users/derrell.nofiel/dev/projects/test/deps/zephyr/arch/riscv/Kconfig"
osource "C:/Users/derrell.nofiel/dev/projects/test/deps/zephyr/arch/posix/Kconfig"
osource "C:/Users/derrell.nofiel/dev/projects/test/deps/zephyr/arch/mips/Kconfig"
osource "C:/Users/derrell.nofiel/dev/projects/test/deps/zephyr/arch/arm64/Kconfig"
osource "C:/Users/derrell.nofiel/dev/projects/test/deps/zephyr/arch/arm/Kconfig"
osource "C:/Users/derrell.nofiel/dev/projects/test/deps/zephyr/arch/arc/Kconfig"
```

## drv2605/build/Kconfig/Kconfig.modules
```kconfig
menu "cmsis-dsp (C:/Users/fayez.saad/Developer/projects/test/deps/modules/lib/cmsis-dsp)"
osource "$(ZEPHYR_CMSIS_DSP_KCONFIG)"
config ZEPHYR_CMSIS_DSP_MODULE
	bool
	default y
endmenu
menu "cmsis_6 (C:/Users/fayez.saad/Developer/projects/test/deps/modules/hal/cmsis_6)"
osource "$(ZEPHYR_CMSIS_6_KCONFIG)"
config ZEPHYR_CMSIS_6_MODULE
	bool
	default y
endmenu
menu "hal_nordic (C:/Users/fayez.saad/Developer/projects/test/deps/modules/hal/nordic)"
osource "$(ZEPHYR_HAL_NORDIC_KCONFIG)"
config ZEPHYR_HAL_NORDIC_MODULE
	bool
	default y

config ZEPHYR_HAL_NORDIC_MODULE_BLOBS
	bool
endmenu
menu "mbedtls (C:/Users/fayez.saad/Developer/projects/test/deps/modules/crypto/mbedtls)"
osource "$(ZEPHYR_MBEDTLS_KCONFIG)"
config ZEPHYR_MBEDTLS_MODULE
	bool
	default y
endmenu
config ZEPHYR_MCUBOOT_MODULE
	bool
	default y
menu "segger (C:/Users/fayez.saad/Developer/projects/test/deps/modules/debug/segger)"
osource "$(ZEPHYR_SEGGER_KCONFIG)"
config ZEPHYR_SEGGER_MODULE
	bool
	default y
endmenu
```

## drv2605/build/Kconfig/Kconfig.sysbuild.modules
```kconfig
config ZEPHYR_CMSIS_DSP_MODULE
   bool
   default y
config ZEPHYR_CMSIS_6_MODULE
   bool
   default y
config ZEPHYR_HAL_NORDIC_MODULE
   bool
   default y
config ZEPHYR_MBEDTLS_MODULE
   bool
   default y
config ZEPHYR_MCUBOOT_MODULE
   bool
   default y
config ZEPHYR_SEGGER_MODULE
   bool
   default y
```

## drv2605/build/Kconfig/arch/Kconfig
```kconfig
# Load Zephyr Arch Kconfig descriptions.
osource "C:/Users/fayez.saad/Developer/projects/test/deps/zephyr/arch/rx/Kconfig"
osource "C:/Users/fayez.saad/Developer/projects/test/deps/zephyr/arch/x86/Kconfig"
osource "C:/Users/fayez.saad/Developer/projects/test/deps/zephyr/arch/xtensa/Kconfig"
osource "C:/Users/fayez.saad/Developer/projects/test/deps/zephyr/arch/sparc/Kconfig"
osource "C:/Users/fayez.saad/Developer/projects/test/deps/zephyr/arch/riscv/Kconfig"
osource "C:/Users/fayez.saad/Developer/projects/test/deps/zephyr/arch/posix/Kconfig"
osource "C:/Users/fayez.saad/Developer/projects/test/deps/zephyr/arch/mips/Kconfig"
osource "C:/Users/fayez.saad/Developer/projects/test/deps/zephyr/arch/arm64/Kconfig"
osource "C:/Users/fayez.saad/Developer/projects/test/deps/zephyr/arch/arm/Kconfig"
osource "C:/Users/fayez.saad/Developer/projects/test/deps/zephyr/arch/arc/Kconfig"
```

## drv2605/build/Kconfig/boards/Kconfig
```kconfig
# Load Zephyr board Kconfig descriptions.
osource "C:/Users/fayez.saad/Developer/projects/test/deps/zephyr/boards/nordic/nrf52840dk/Kconfig"
```

## lib/api/light/Kconfig
```kconfig
config TMI_API_LIGHT
	bool "Enable LIGHT API"
	default n
  help
    TMI Light API enable
```

## lib/api/pressure/Kconfig
```kconfig
config TMI_API_PRESSURE
	bool "Enable PRESSURE API"
	default n
  help
    TMI Pressure API enable
```

## lib/custom_drivers/mpu6050/Kconfig
```kconfig
config CUSTOM_MPU6050
	bool "Enable MPU6050 IMU"
	default n
	select I2C
	select FPU
  help
    MPU6050 enable
```

## lib/drivers/bme280/Kconfig
```kconfig
config TMI_DRIVER_BME280
	bool "Enable BME280 IMU"
	default n
	select I2C
	select FPU
	select TMI_API_PRESSURE
  help
    BME280 enable


config TMI_DRIVER_BME280_INIT_PRIORITY
	int "BME280	init priority"
	default 90
	depends on TMI_DRIVER_BME280
	help
	  BME280 initialization priority.
```

## lib/drivers/cls16d24/Kconfig
```kconfig
config CUSTOM_CLS16D24
	bool "Enable CLS16D24"
	default n
	select I2C
	select FPU
  help
    CLS16D24 enable
```

## lib/dts/bindings/tmi,bme280.yaml
```yaml
description: bme pressure tracking device

compatible: "tmi,bme280"

include: [i2c-device.yaml]

properties:

  temp:
    type: int
    default: 2
    description: |
      temperature scale.

  hum:
    type: int
    default: 2
    description: |
      humitidy full-scale range.
  

  press:
    type: int
    default: 2
    description: |
      Pressure full scale range.

  filter:
    type: int
    default: 2
    description: |
      Filter full scale range. 
```

## lib/dts/bindings/tmi,xgzp6897d.yaml
```yaml
description: xgzp6897d dual port differential pressure monitoring device. 
compatible: "tmi,xgzp6897d"

include: [ i2c-device.yaml]
```

## samples/TCS3400sendriver/build/Kconfig/Kconfig.modules
```kconfig
menu "cmsis_6 (C:/Users/derrell.nofiel/dev/projects/test/deps/modules/hal/cmsis_6)"
osource "$(ZEPHYR_CMSIS_6_KCONFIG)"
config ZEPHYR_CMSIS_6_MODULE
	bool
	default y
endmenu
menu "hal_nordic (C:/Users/derrell.nofiel/dev/projects/test/deps/modules/hal/nordic)"
osource "$(ZEPHYR_HAL_NORDIC_KCONFIG)"
config ZEPHYR_HAL_NORDIC_MODULE
	bool
	default y

config ZEPHYR_HAL_NORDIC_MODULE_BLOBS
	bool
endmenu
```

## samples/TCS3400sendriver/build/Kconfig/boards/Kconfig.defconfig
```kconfig
# Load Zephyr board defconfig descriptions.
osource "C:/Users/derrell.nofiel/dev/projects/test/deps/zephyr/boards/nordic/nrf52840dk/Kconfig.defconfig"
```

## samples/TCS3400sendriver/build/Kconfig/boards/Kconfig.sysbuild
```kconfig
# Load Sysbuild board Kconfig descriptions.
osource "C:/Users/derrell.nofiel/dev/projects/test/deps/zephyr/boards/nordic/nrf52840dk/Kconfig.sysbuild"
```
